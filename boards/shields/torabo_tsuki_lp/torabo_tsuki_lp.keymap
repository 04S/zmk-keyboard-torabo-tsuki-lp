// OS設定を日本語キーボードのまま使用するための変換定義
#define JP_DQUOTE       AT                // "
#define JP_AMPERSAND    CARET             // &
#define JP_QUOTE        AMPERSAND         // '
#define JP_EQUAL        UNDER             // =
#define JP_CARET        EQUAL             // ^
#define JP_YEN          0x89              // ¥
#define JP_PLUS         COLON             // +
#define JP_TILDE        PLUS              // ~
#define JP_PIPE         LS(0x89)          // |
#define JP_AT           LEFT_BRACKET      // @
#define JP_COLON        SINGLE_QUOTE      // :
#define JP_ASTERISK     DOUBLE_QUOTES     // *
#define JP_BACKQUOTE    LEFT_BRACE        // `
#define JP_UNDERSCORE   LS(0x87)          // _
#define JP_LBRACKET     RIGHT_BRACKET     // [
#define JP_RBRACKET     BACKSLASH         // ]
#define JP_LPAREN       ASTERISK          // (
#define JP_RPAREN       LEFT_PARENTHESIS  // )
#define JP_LBRACE       RIGHT_BRACE       // {
#define JP_RBRACE       PIPE              // }
#define JP_KANA         LANGUAGE_1        // かな
#define JP_EISU         LANGUAGE_2        // 英数
#define JP_HANZEN       GRAVE             // 半角/全角

#include "../../../config/keymap.keymap"




#include <zmk,layer-listeners.yaml>

/ {
    // スニペットが探している「受け皿」を定義
    layer_listeners: layer_listeners {
        compatible = "zmk,input-listener";
        status = "okay";
    };

    keymap {
        // ... 既存のレイヤー定義（layer_0, layer_1...） ...
    };
}; // ← ここで keymap やルートノードの { } がすべて閉じられます

// ★★★ 2. の記述はこの「外側」に書きます ★★★
&layer_listeners {
    scroll_layer {
        layers = <5>; // スクロールにしたいレイヤー番号
        input-processors = <&zip_xy_scaler 1 20>, <&zip_xy_to_scroll_mapper>;
    };
    
    // 他のレイヤー設定が必要ならここに追加していく
};
