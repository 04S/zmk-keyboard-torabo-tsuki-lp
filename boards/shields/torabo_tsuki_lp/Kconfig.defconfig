## boards/shields/torabo_tsuki_lp/Kconfig.defconfig
```kconfig
if SHIELD_TORABO_TSUKI_LP_LEFT || SHIELD_TORABO_TSUKI_LP_RIGHT

config ZMK_KEYBOARD_NAME
    default "torabo-tsuki"

config ZMK_SPLIT
    default y

config SPI
    default y

config INPUT
    default y

config ZMK_MOUSE
    default y

// トラックパッド用
config ZMK_POINTING
    default y

config IQS7211E
    default y

endif
```
